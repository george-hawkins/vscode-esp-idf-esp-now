## examples/experiments/sdkconfig.defaults
```kconfig
# Enable features needed for vTaskList.
CONFIG_FREERTOS_USE_TRACE_FACILITY=y
CONFIG_FREERTOS_USE_STATS_FORMATTING_FUNCTIONS=y

# Enable features needed for heap_caps_get_per_task_info.
CONFIG_HEAP_TASK_TRACKING=y
```
